;;*****************************************************************************
;;*****************************************************************************
;;  FILENAME: declencheur.inc
;;   Version: 2.6, Updated on 2009/10/15 at 17:11:37
;;  Generated by PSoC Designer 5.0.1127.0
;;
;;  DESCRIPTION: Assembler declarations for the Timer16 user module interface
;;-----------------------------------------------------------------------------
;;  Copyright (c) Cypress Semiconductor 2009. All Rights Reserved.
;;*****************************************************************************
;;*****************************************************************************

include "m8c.inc"


;--------------------------------------------------
; Constants for declencheur API's.
;--------------------------------------------------

declencheur_CONTROL_REG_START_BIT:         equ 0x01    ; Control register start bit
declencheur_INT_REG:                       equ 0x0e1
declencheur_INT_MASK:                      equ 0x20


;--------------------------------------------------
; Constants for declencheur user defined values
;--------------------------------------------------

declencheur_PERIOD:                        equ 0xea60
declencheur_COMPARE_VALUE:                 equ 0x0


;--------------------------------------------------
; Register Address Constants for declencheur
;--------------------------------------------------

declencheur_COUNTER_LSB_REG:           equ 0x30   ; DR0 Counter register
declencheur_COUNTER_MSB_REG:           equ 0x34
declencheur_PERIOD_LSB_REG:            equ 0x31   ; DR1 Period register
declencheur_PERIOD_MSB_REG:            equ 0x35
declencheur_COMPARE_LSB_REG:           equ 0x32   ; DR2 CompareValue register
declencheur_COMPARE_MSB_REG:           equ 0x36
declencheur_CONTROL_LSB_REG:           equ 0x33   ; Control register
declencheur_CONTROL_MSB_REG:           equ 0x37
declencheur_FUNC_LSB_REG:              equ 0x30   ; Function register
declencheur_FUNC_MSB_REG:              equ 0x34
declencheur_INPUT_LSB_REG:             equ 0x31   ; Input register
declencheur_INPUT_MSB_REG:             equ 0x35
declencheur_OUTPUT_LSB_REG:            equ 0x32   ; Output register
declencheur_OUTPUT_MSB_REG:            equ 0x36


;--------------------------------------------------
; declencheur Macro 'Functions'
;--------------------------------------------------

   macro declencheur_Start_M
   or    reg[declencheur_CONTROL_LSB_REG],  declencheur_CONTROL_REG_START_BIT
   endm

   macro declencheur_Stop_M
   and   reg[declencheur_CONTROL_LSB_REG], ~declencheur_CONTROL_REG_START_BIT
   endm

   macro declencheur_EnableInt_M
   M8C_EnableIntMask declencheur_INT_REG, declencheur_INT_MASK
   endm

   macro declencheur_DisableInt_M
   M8C_DisableIntMask declencheur_INT_REG, declencheur_INT_MASK
   endm


; end of file declencheur.inc
