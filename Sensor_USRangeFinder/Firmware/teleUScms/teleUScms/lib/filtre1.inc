;;*****************************************************************************
;;*****************************************************************************
;;  FILENAME: filtre1.inc
;;   Version: 5.5, Updated on 2009/10/9 at 10:6:29
;;  Generated by PSoC Designer 5.0.1127.0
;;
;;  DESCRIPTION: Assembler declarations for the BPF2 user module interface
;;-----------------------------------------------------------------------------
;;  Copyright (c) Cypress Semiconductor 2009. All Rights Reserved.
;;*****************************************************************************
;;*****************************************************************************

include "m8c.inc"

;--------------------------------------------------
; Register constants and masks
;--------------------------------------------------
filtre1_OFF:                                     equ 0
filtre1_LOWPOWER:                                equ 1
filtre1_MEDPOWER:                                equ 2
filtre1_HIGHPOWER:                               equ 3

filtre1_FEEDBACK_16:                             equ 0
filtre1_FEEDBACK_32:                             equ 1

filtre1_POLARITY_INVERTING:                      equ 0
filtre1_POLARITY_NON_INVERTING:                  equ 1

;--------------------------------------------------
; Registers used by filtre1
;--------------------------------------------------

filtre1_FLIN_CR0:   equ 80h                      ; SCA Block Control Register 0
filtre1_FLIN_CR1:   equ 81h                      ; SCA Block Control Register 1
filtre1_FLIN_CR2:   equ 82h                      ; SCA Block Control Register 2
filtre1_FLIN_CR3:   equ 83h                      ; SCA Block Control Register 3
filtre1_FLFB_CR0:   equ 90h                      ; SCA Block Control Register 0
filtre1_FLFB_CR1:   equ 91h                      ; SCA Block Control Register 1
filtre1_FLFB_CR2:   equ 92h                      ; SCA Block Control Register 2
filtre1_FLFB_CR3:   equ 93h                      ; SCA Block Control Register 3

; UM Cap naming convention per Gregorian and Temes, p293

filtre1_FILT_C1_REG:    equ 80h
filtre1_FILT_C2_REG:    equ 81h
filtre1_FILT_C3_REG:    equ 90h
filtre1_FILT_C4_REG:    equ 82h
filtre1_FILT_CA_REG:    equ 80h
filtre1_FILT_CB_REG:    equ 90h

; end of file filtre1.inc
