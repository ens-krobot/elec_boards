;;*****************************************************************************
;;*****************************************************************************
;;  FILENAME: porteuse.inc
;;   Version: 2.6, Updated on 2009/10/15 at 17:11:37
;;  Generated by PSoC Designer 5.0.1127.0
;;
;;  DESCRIPTION: Assembler declarations for the Timer8 user module interface
;;-----------------------------------------------------------------------------
;;  Copyright (c) Cypress Semiconductor 2009. All Rights Reserved.
;;*****************************************************************************
;;*****************************************************************************

include "m8c.inc"


;--------------------------------------------------
; Constants for porteuse API's.
;--------------------------------------------------

porteuse_CONTROL_REG_START_BIT:            equ 0x01    ; Control register start bit
porteuse_INT_REG:                          equ 0x0e1
porteuse_INT_MASK:                         equ 0x01


;--------------------------------------------------
; Constants for porteuse user defined values
;--------------------------------------------------

porteuse_PERIOD:                           equ 0xf0
porteuse_COMPARE_VALUE:                    equ 0x78


;--------------------------------------------------
; Register Address Constants for porteuse
;--------------------------------------------------

porteuse_COUNTER_REG:                  equ 0x20   ; DR0 Counter register
porteuse_PERIOD_REG:                   equ 0x21   ; DR1 Period register
porteuse_COMPARE_REG:                  equ 0x22   ; DR2 CompareValue register
porteuse_CONTROL_REG:                  equ 0x23   ; Control register
porteuse_FUNC_REG:                     equ 0x20   ; Function register
porteuse_INPUT_REG:                    equ 0x21   ; Input register
porteuse_OUTPUT_REG:                   equ 0x22   ; Output register


;--------------------------------------------------
; porteuse Macro 'Functions'
;--------------------------------------------------

   macro porteuse_Start_M
   or    reg[porteuse_CONTROL_REG],  porteuse_CONTROL_REG_START_BIT
   endm

   macro porteuse_Stop_M
   and   reg[porteuse_CONTROL_REG], ~porteuse_CONTROL_REG_START_BIT
   endm

   macro porteuse_EnableInt_M
   M8C_EnableIntMask porteuse_INT_REG, porteuse_INT_MASK
   endm

   macro porteuse_DisableInt_M
   M8C_DisableIntMask porteuse_INT_REG, porteuse_INT_MASK
   endm


; end of file porteuse.inc
