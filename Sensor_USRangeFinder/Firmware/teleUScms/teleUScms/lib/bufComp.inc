;;*****************************************************************************
;;*****************************************************************************
;;  FILENAME: bufComp.inc
;;  Version: 1.3, Updated on 2009/10/15 at 17:11:37
;;  Generated by PSoC Designer 5.0.1127.0
;;
;;  DESCRIPTION: Assembler declarations for the Counter8 user module interface
;;-----------------------------------------------------------------------------
;;  Copyright (c) Cypress Semiconductor 2009. All Rights Reserved.
;;*****************************************************************************
;;*****************************************************************************

include "m8c.inc"


;--------------------------------------------------
; Constants for bufComp API's.
;--------------------------------------------------

bufComp_CONTROL_REG_START_BIT:             equ 0x01    ; Control register start bit
bufComp_INT_REG:                           equ 0x0df
bufComp_INT_MASK:                          equ 0x08


;--------------------------------------------------
; Register Address Constants for bufComp
;--------------------------------------------------

bufComp_DATA_0_REG:                    equ 0x4c   ; DR0 register
bufComp_DATA_1_REG:                    equ 0x4d   ; DR1 register
bufComp_DATA_2_REG:                    equ 0x4e   ; DR2 register
bufComp_CONTROL_REG:                   equ 0x4f   ; Control register
bufComp_FUNC_REG:                      equ 0x4c   ; Function register
bufComp_INPUT_REG:                     equ 0x4d   ; Input register
bufComp_OUTPUT_REG:                    equ 0x4e   ; Output register


;--------------------------------------------------
; bufComp Macro 'Functions'
;--------------------------------------------------

   macro bufComp_Start_M
   or    reg[bufComp_CONTROL_REG],  bufComp_CONTROL_REG_START_BIT
   endm

   macro bufComp_Stop_M
   and   reg[bufComp_CONTROL_REG], ~bufComp_CONTROL_REG_START_BIT
   endm

   macro bufComp_EnableInt_M
   M8C_EnableIntMask bufComp_INT_REG, bufComp_INT_MASK
   endm

   macro bufComp_DisableInt_M
   M8C_DisableIntMask bufComp_INT_REG, bufComp_INT_MASK
   endm


; end of file bufComp.inc
