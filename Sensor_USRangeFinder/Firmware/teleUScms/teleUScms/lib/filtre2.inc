;;*****************************************************************************
;;*****************************************************************************
;;  FILENAME: filtre2.inc
;;   Version: 5.5, Updated on 2009/10/9 at 10:6:29
;;  Generated by PSoC Designer 5.0.1127.0
;;
;;  DESCRIPTION: Assembler declarations for the BPF2 user module interface
;;-----------------------------------------------------------------------------
;;  Copyright (c) Cypress Semiconductor 2009. All Rights Reserved.
;;*****************************************************************************
;;*****************************************************************************

include "m8c.inc"

;--------------------------------------------------
; Register constants and masks
;--------------------------------------------------
filtre2_OFF:                                     equ 0
filtre2_LOWPOWER:                                equ 1
filtre2_MEDPOWER:                                equ 2
filtre2_HIGHPOWER:                               equ 3

filtre2_FEEDBACK_16:                             equ 0
filtre2_FEEDBACK_32:                             equ 1

filtre2_POLARITY_INVERTING:                      equ 0
filtre2_POLARITY_NON_INVERTING:                  equ 1

;--------------------------------------------------
; Registers used by filtre2
;--------------------------------------------------

filtre2_FLIN_CR0:   equ 88h                      ; SCA Block Control Register 0
filtre2_FLIN_CR1:   equ 89h                      ; SCA Block Control Register 1
filtre2_FLIN_CR2:   equ 8ah                      ; SCA Block Control Register 2
filtre2_FLIN_CR3:   equ 8bh                      ; SCA Block Control Register 3
filtre2_FLFB_CR0:   equ 98h                      ; SCA Block Control Register 0
filtre2_FLFB_CR1:   equ 99h                      ; SCA Block Control Register 1
filtre2_FLFB_CR2:   equ 9ah                      ; SCA Block Control Register 2
filtre2_FLFB_CR3:   equ 9bh                      ; SCA Block Control Register 3

; UM Cap naming convention per Gregorian and Temes, p293

filtre2_FILT_C1_REG:    equ 88h
filtre2_FILT_C2_REG:    equ 89h
filtre2_FILT_C3_REG:    equ 98h
filtre2_FILT_C4_REG:    equ 8ah
filtre2_FILT_CA_REG:    equ 88h
filtre2_FILT_CB_REG:    equ 98h

; end of file filtre2.inc
