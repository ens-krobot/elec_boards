;;*****************************************************************************
;;*****************************************************************************
;;  FILENAME:   comp.inc
;;  Version: 3.3, Updated on 2009/10/9 at 10:6:29
;;  Generated by PSoC Designer 5.0.1127.0
;;
;;  DESCRIPTION:  Assembler declarations for the CMPPRG user module interface.
;;-----------------------------------------------------------------------------
;;  Copyright (c) Cypress Semiconductor 2009. All Rights Reserved.
;;*****************************************************************************
;;*****************************************************************************


;--------------------------------------------------
; Constants for comp API's
;--------------------------------------------------
comp_OFF:        equ 0
comp_LOWPOWER:   equ 1
comp_MEDPOWER:   equ 2
comp_HIGHPOWER:  equ 3

comp_REF1_000:   equ f0h
comp_REF0_937:   equ e0h
comp_REF0_875:   equ d0h
comp_REF0_812:   equ c0h
comp_REF0_750:   equ b0h
comp_REF0_688:   equ a0h
comp_REF0_625:   equ 90h
comp_REF0_562:   equ 80h
comp_REF0_500:   equ 70h
comp_REF0_437:   equ 60h
comp_REF0_375:   equ 50h
comp_REF0_312:   equ 40h
comp_REF0_250:   equ 30h
comp_REF0_188:   equ 20h
comp_REF0_125:   equ 10h
comp_REF0_062:   equ 00h
comp_REF0_042:   equ 14h
comp_REF0_021:   equ 04h

;--------------------------------------------------
; Register Address Constants for comp
;--------------------------------------------------
comp_COMP_CR0:  equ 7dh
comp_COMP_CR1:  equ 7eh
comp_COMP_CR2:  equ 7fh
comp_COMP_CR3:  equ 7ch

; end of file comp.inc
