;;*****************************************************************************
;;*****************************************************************************
;;  FILENAME: inverseur.inc
;;   Version: 1.5, Updated on 2009/10/15 at 17:11:37
;;  Generated by PSoC Designer 5.0.1127.0
;;
;;  DESCRIPTION:
;;    Assembler include file of inverseur instance of DigInv
;;    user module.
;;-----------------------------------------------------------------------------
;;  Copyright (c) Cypress Semiconductor 2009. All Rights Reserved.
;;*****************************************************************************
;;*****************************************************************************

;--------------------------------------------------
; Constants for inverseur API's
;--------------------------------------------------

;mask value for global int reg bit for DigInv instance
inverseur_bINT_MASK:         equ 02h
;RX8 interrupt address
inverseur_INT_REG:          equ 0e1h

;--------------------------------------------------
; Registers used by inverseur
;--------------------------------------------------
inverseur_CONTROL_REG:  equ 27h                  ;Control register
inverseur_COUNTER_REG:  equ 24h                  ;Counter register
inverseur_PERIOD_REG:   equ 25h                  ;Period value register
inverseur_COMPARE_REG:  equ 26h                  ;CompareValue register
inverseur_FUNC_REG: equ 24h                      ;Function register
inverseur_INPUT_REG:    equ 25h                  ;Input register
inverseur_OUTPUT_REG:   equ 26h                  ;Output register

; end of file inverseur.inc
