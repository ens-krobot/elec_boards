; Generated by PSoC Designer 5.0.1127.0
;
; AnalogOutBuf_3 address and mask equates
AnalogOutBuf_3_Data_ADDR:	equ	0h
AnalogOutBuf_3_DriveMode_0_ADDR:	equ	100h
AnalogOutBuf_3_DriveMode_1_ADDR:	equ	101h
AnalogOutBuf_3_DriveMode_2_ADDR:	equ	3h
AnalogOutBuf_3_GlobalSelect_ADDR:	equ	2h
AnalogOutBuf_3_IntCtrl_0_ADDR:	equ	102h
AnalogOutBuf_3_IntCtrl_1_ADDR:	equ	103h
AnalogOutBuf_3_IntEn_ADDR:	equ	1h
AnalogOutBuf_3_MASK:	equ	4h
; AnalogOutBuf_0 address and mask equates
AnalogOutBuf_0_Data_ADDR:	equ	0h
AnalogOutBuf_0_DriveMode_0_ADDR:	equ	100h
AnalogOutBuf_0_DriveMode_1_ADDR:	equ	101h
AnalogOutBuf_0_DriveMode_2_ADDR:	equ	3h
AnalogOutBuf_0_GlobalSelect_ADDR:	equ	2h
AnalogOutBuf_0_IntCtrl_0_ADDR:	equ	102h
AnalogOutBuf_0_IntCtrl_1_ADDR:	equ	103h
AnalogOutBuf_0_IntEn_ADDR:	equ	1h
AnalogOutBuf_0_MASK:	equ	8h
; AnalogOutBuf_2 address and mask equates
AnalogOutBuf_2_Data_ADDR:	equ	0h
AnalogOutBuf_2_DriveMode_0_ADDR:	equ	100h
AnalogOutBuf_2_DriveMode_1_ADDR:	equ	101h
AnalogOutBuf_2_DriveMode_2_ADDR:	equ	3h
AnalogOutBuf_2_GlobalSelect_ADDR:	equ	2h
AnalogOutBuf_2_IntCtrl_0_ADDR:	equ	102h
AnalogOutBuf_2_IntCtrl_1_ADDR:	equ	103h
AnalogOutBuf_2_IntEn_ADDR:	equ	1h
AnalogOutBuf_2_MASK:	equ	10h
; AnalogOutBuf_1 address and mask equates
AnalogOutBuf_1_Data_ADDR:	equ	0h
AnalogOutBuf_1_DriveMode_0_ADDR:	equ	100h
AnalogOutBuf_1_DriveMode_1_ADDR:	equ	101h
AnalogOutBuf_1_DriveMode_2_ADDR:	equ	3h
AnalogOutBuf_1_GlobalSelect_ADDR:	equ	2h
AnalogOutBuf_1_IntCtrl_0_ADDR:	equ	102h
AnalogOutBuf_1_IntCtrl_1_ADDR:	equ	103h
AnalogOutBuf_1_IntEn_ADDR:	equ	1h
AnalogOutBuf_1_MASK:	equ	20h
; I2CHWSDA address and mask equates
I2CHWSDA_Data_ADDR:	equ	4h
I2CHWSDA_DriveMode_0_ADDR:	equ	104h
I2CHWSDA_DriveMode_1_ADDR:	equ	105h
I2CHWSDA_DriveMode_2_ADDR:	equ	7h
I2CHWSDA_GlobalSelect_ADDR:	equ	6h
I2CHWSDA_IntCtrl_0_ADDR:	equ	106h
I2CHWSDA_IntCtrl_1_ADDR:	equ	107h
I2CHWSDA_IntEn_ADDR:	equ	5h
I2CHWSDA_MASK:	equ	20h
; I2CHWSCL address and mask equates
I2CHWSCL_Data_ADDR:	equ	4h
I2CHWSCL_DriveMode_0_ADDR:	equ	104h
I2CHWSCL_DriveMode_1_ADDR:	equ	105h
I2CHWSCL_DriveMode_2_ADDR:	equ	7h
I2CHWSCL_GlobalSelect_ADDR:	equ	6h
I2CHWSCL_IntCtrl_0_ADDR:	equ	106h
I2CHWSCL_IntCtrl_1_ADDR:	equ	107h
I2CHWSCL_IntEn_ADDR:	equ	5h
I2CHWSCL_MASK:	equ	80h
