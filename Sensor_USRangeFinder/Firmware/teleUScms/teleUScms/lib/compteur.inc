;;*****************************************************************************
;;*****************************************************************************
;;  FILENAME: compteur.inc
;;   Version: 1.1, Updated on 2009/10/15 at 17:11:37
;;  Generated by PSoC Designer 5.0.1127.0
;;
;;  DESCRIPTION: Assembler declarations for the Timer16 user module interface
;;-----------------------------------------------------------------------------
;;  Copyright (c) Cypress Semiconductor 2009. All Rights Reserved.
;;*****************************************************************************
;;*****************************************************************************

include "m8c.inc"


;--------------------------------------------------
; Constants for compteur API's.
;--------------------------------------------------

compteur_CONTROL_REG_START_BIT:            equ 0x01    ; Control register start bit
compteur_MSB_INT_REG:                      equ 0x0df
compteur_MSB_INT_MASK:                     equ 0x04
compteur_LSB_INT_REG:                      equ 0x0df
compteur_LSB_INT_MASK:                     equ 0x02


;--------------------------------------------------
; Constants for compteur user defined values
;--------------------------------------------------

compteur_PERIOD:                           equ 0xea60
compteur_COMPARE_VALUE:                    equ 0xea0a


;--------------------------------------------------
; Register Address Constants for compteur
;--------------------------------------------------

compteur_COUNTER_LSB_REG:              equ 0x44   ; DR0 Counter register
compteur_COUNTER_MSB_REG:              equ 0x48
compteur_PERIOD_LSB_REG:               equ 0x45   ; DR1 Period register
compteur_PERIOD_MSB_REG:               equ 0x49
compteur_COMPARE_LSB_REG:              equ 0x46   ; DR2 CompareValue register
compteur_COMPARE_MSB_REG:              equ 0x4a
compteur_CONTROL_LSB_REG:              equ 0x47   ; Control register
compteur_CONTROL_MSB_REG:              equ 0x4b
compteur_FUNC_LSB_REG:                 equ 0x44   ; Function register
compteur_FUNC_MSB_REG:                 equ 0x48
compteur_INPUT_LSB_REG:                equ 0x45   ; Input register
compteur_INPUT_MSB_REG:                equ 0x49
compteur_OUTPUT_LSB_REG:               equ 0x46   ; Output register
compteur_OUTPUT_MSB_REG:               equ 0x4a


;--------------------------------------------------
; compteur Macro 'Functions'
;--------------------------------------------------

   macro compteur_Start_M
   or    reg[compteur_CONTROL_LSB_REG],  compteur_CONTROL_REG_START_BIT
   endm

   macro compteur_Stop_M
   and   reg[compteur_CONTROL_LSB_REG], ~compteur_CONTROL_REG_START_BIT
   endm

   macro compteur_EnableInt_M
   M8C_EnableIntMask compteur_MSB_INT_REG, compteur_MSB_INT_MASK
   M8C_EnableIntMask compteur_LSB_INT_REG, compteur_LSB_INT_MASK
   endm

   macro compteur_EnableTerminalInt_M
   M8C_EnableIntMask compteur_MSB_INT_REG, compteur_MSB_INT_MASK
   endm

   macro compteur_EnableCaptureInt_M
   M8C_EnableIntMask compteur_LSB_INT_REG, compteur_LSB_INT_MASK
   endm

   macro compteur_DisableInt_M
   M8C_DisableIntMask compteur_MSB_INT_REG, compteur_MSB_INT_MASK
   M8C_DisableIntMask compteur_LSB_INT_REG, compteur_LSB_INT_MASK
   endm

   macro compteur_DisableTerminalInt_M
   M8C_DisableIntMask compteur_MSB_INT_REG, compteur_MSB_INT_MASK
   endm

   macro compteur_DisableCaptureInt_M
   M8C_DisableIntMask compteur_LSB_INT_REG, compteur_LSB_INT_MASK
   endm


; end of file compteur.inc
