;;*****************************************************************************
;;*****************************************************************************
;;  FILENAME: tempsMort.inc
;;   Version: 2.6, Updated on 2009/10/15 at 17:11:37
;;  Generated by PSoC Designer 5.0.1127.0
;;
;;  DESCRIPTION: Assembler declarations for the Timer8 user module interface
;;-----------------------------------------------------------------------------
;;  Copyright (c) Cypress Semiconductor 2009. All Rights Reserved.
;;*****************************************************************************
;;*****************************************************************************

include "m8c.inc"


;--------------------------------------------------
; Constants for tempsMort API's.
;--------------------------------------------------

tempsMort_CONTROL_REG_START_BIT:           equ 0x01    ; Control register start bit
tempsMort_INT_REG:                         equ 0x0df
tempsMort_INT_MASK:                        equ 0x01


;--------------------------------------------------
; Constants for tempsMort user defined values
;--------------------------------------------------

tempsMort_PERIOD:                          equ 0x56
tempsMort_COMPARE_VALUE:                   equ 0x00


;--------------------------------------------------
; Register Address Constants for tempsMort
;--------------------------------------------------

tempsMort_COUNTER_REG:                 equ 0x40   ; DR0 Counter register
tempsMort_PERIOD_REG:                  equ 0x41   ; DR1 Period register
tempsMort_COMPARE_REG:                 equ 0x42   ; DR2 CompareValue register
tempsMort_CONTROL_REG:                 equ 0x43   ; Control register
tempsMort_FUNC_REG:                    equ 0x40   ; Function register
tempsMort_INPUT_REG:                   equ 0x41   ; Input register
tempsMort_OUTPUT_REG:                  equ 0x42   ; Output register


;--------------------------------------------------
; tempsMort Macro 'Functions'
;--------------------------------------------------

   macro tempsMort_Start_M
   or    reg[tempsMort_CONTROL_REG],  tempsMort_CONTROL_REG_START_BIT
   endm

   macro tempsMort_Stop_M
   and   reg[tempsMort_CONTROL_REG], ~tempsMort_CONTROL_REG_START_BIT
   endm

   macro tempsMort_EnableInt_M
   M8C_EnableIntMask tempsMort_INT_REG, tempsMort_INT_MASK
   endm

   macro tempsMort_DisableInt_M
   M8C_DisableIntMask tempsMort_INT_REG, tempsMort_INT_MASK
   endm


; end of file tempsMort.inc
